## arch/arm/mach-msm/pantech/Kconfig
```kconfig
config CUST_SKY_H
	bool

menu "Pantech Board Selection"
source "arch/arm/mach-msm/pantech/Kconfig.board"
endmenu
```

## arch/arm/mach-msm/pantech/Kconfig.board
```kconfig
#
# Include the specific Kconfig file for Pantech boards
#

# PRESTO
source "arch/arm/mach-msm/pantech/presto/Kconfig"

config MACH_PANTECH_DUMMY
	depends on CUST_SKY_H
	bool "NONE (No device)"

config PANTECH
	bool "PANTECH Common Configuration"
	default y
	help
	  Use this config to add codes or avoid orphan codes, that's
	  not labeled with a: CONFIG or FEATURE

config PANTECH_ATNT
	bool
	help
	  Support PANTECH

config PANTECH_QUANTINA_BOARD
	bool "PANTECH_QUANTINA_BOARD Configuration"

config SKY_GSBI12_UART_CONSOLE
	bool "SKY_GSBI12_UART_CONSOLE Configuration"

config SKY_SND_CTRL
	bool

config SKY_SND_EXTAMP
	bool

config SKY_SND_MVS
	bool

config SKY_SND_VT_VOIP
	bool

config SKY_MMC
	bool "PANTECH MMC Configuration"

config PANTECH_WIFI_MMC
	bool

config SKY_WLAN_MMC
	bool

config PANTECH_ERR_CRASH_LOGGING
	bool "PANTECH_ERR_CRASH_LOGGING Configuration"

config PANTECH_PWR_ONOFF_REASON_CNT
	bool "PANTECH_PWR_ONOFF_REASON_CNT Configuration"

config SW_RESET
	bool "SW_RESET Configuration"
	depends on PANTECH_ERR_CRASH_LOGGING
	depends on PANTECH_PWR_ONOFF_REASON_CNT

config PANTECH_WDOG_WORKAROUND
	bool "PANTECH_WDOG_WORKAROUND Configuration"
	depends on SW_RESET

config PANTECH_EXT4_RO_REMOUNT_ON_EMERGENCY_RESET
	bool "SW_RESET Configuration"
	help
	  Add 4 new commands to the reboot system call, that do the same thing as the
	  RESTART, HALT, POWER_OFF, and RESTART2 commands, but also remount writable
	  filesystems as read-only just before doing what the command normally does.
	  Now that Android is using EXT4, and since we don't have a standard init
	  setup to unmount filesystems before rebooting, this allows the system to
	  reboot with clean filesystems, and also improves boot time as the journal
	  does not need to be replayed when mounting the filesystem.

config PANTECH_KERNEL_FS_FIX
	bool "The patch of EXT4 Jounaling problem"
	default n
	help
	  Patch kernel source.

config AVOID_COMPILE_ERRORS
	bool "Patch to avoid kernel compile errors"
	default n

config BUG_FIX_LCD_YUV_REVERSE
	bool

config F_SKYDISP_QBUG_FIX_BACKLIGHT
	bool

config F_SKYDISP_BOOT_LOGO_IN_KERNEL
	bool

config F_SKYDISP_LCD_RESET
	bool

config F_SKYDISP_LCD_FORCE_ONOFF
	bool

config F_SKYDISP_QBUG_FIX_MIPI_ERROR
	bool

config F_SKYDISP_FRAMEBUFFER_32
	bool

config F_SKYDISP_NO_CURSOR_IN_BOOT
	bool

config F_SKYDISP_HDMI_OPTION
	bool

config F_SKYDISP_USE_ASHMEM
	bool

config F_SKYDISP_FIX_OVERLAY_FLICKER
	bool

config F_SKYDISP_BEAM_ON_BUG_FIX
	bool

config F_SKYDISP_ICS_MSM_FB_ALIGNED_4K_PAGE_BOUNDARY
	bool

config FEATURE_SKY_PDL_DLOAD
	bool

comment "Continued the standard kernel"
```

## arch/arm/mach-msm/pantech/presto/Kconfig
```kconfig
config MACH_MSM8X60_PRESTO
	depends on ARCH_MSM8X60
	default n
	bool "MSM8X60 PRESTO"
	select CUST_SKY_H
	select DEFINE_LIST_PRESTO
	help
	  Support for the Pantech MSM8x60 PRESTO project board.

if MACH_MSM8X60_PRESTO
config DEFINE_LIST_PRESTO
	bool
	default y
	select PANTECH
	select PANTECH_ATNT
	select PANTECH_PRESTO_BOARD
	select PANTECH_CAMERA
	select PANTECH_AUDIO_PRESTO_AUDIENCE2020
	select PANTECH_AUDIO_PRESTO_FAB2200
	select PANTECH_AUDIO_SUBCHIP_CAL_TOOL
	select PANTECH_WIFI_MMC
	select PANTECH_ERR_CRASH_LOGGING
	select PANTECH_PWR_ONOFF_REASON_CNT
	select SW_RESET
	select PANTECH_WDOG_WORKAROUND
	select PANTECH_EXT4_RO_REMOUNT_ON_EMERGENCY_RESET
	select SKY_SND_CTRL
	select SKY_MMC
	select BUG_FIX_LCD_YUV_REVERSE
	select F_SKYDISP_QBUG_FIX_BACKLIGHT
	select F_SKYDISP_BOOT_LOGO_IN_KERNEL
	select F_SKYDISP_LCD_FORCE_ONOFF
	select F_SKYDISP_LCD_RESET
	select F_SKYDISP_FRAMEBUFFER_32
	select F_SKYDISP_NO_CURSOR_IN_BOOT
	select F_SKYDISP_BEAM_ON_BUG_FIX
	select F_SKYDISP_FIX_OVERLAY_FLICKER
	select PANTECH_KERNEL_FS_FIX
	select F_SKYDISP_ICS_MSM_FB_ALIGNED_4K_PAGE_BOUNDARY
	select PANTECH_PRESTO_LEDS_PMIC
	select PANTECH_PRESTO_VIBRATOR_PATCH
	select FEATURE_SKY_PDL_DLOAD
endif

config PANTECH_PRESTO_BOARD
	bool "PANTECH_PRESTO_BOARD Configuration"

config PANTECH_AUDIO_PRESTO_AUDIENCE2020
	bool

config PANTECH_AUDIO_PRESTO_FAB2200
	bool

config PANTECH_AUDIO_SUBCHIP_CAL_TOOL
	bool

config PANTECH_PRESTO_LEDS_PMIC
	bool

config PANTECH_PRESTO_VIBRATOR_PATCH
	bool
```

## drivers/input/pantech_earjack_int/Kconfig
```kconfig
#
# Earjack driver configuration
#

menuconfig INPUT_EARJACK
	bool "Earjack"
	depends on CUST_SKY_H
	default n
	help 
	  Say Y here, and a list of supported sensorss will be displayed.
	  This option doesn't affect the kernel.

	  If unsure, say Y.

if INPUT_EARJACK
config INPUT_PANTECH_EARJACK
	tristate "Pantech Earjack Device"
	depends on CUST_SKY_H
	default y
	help
	  Say Y here if you have pantech earjack.
endif
```

## drivers/input/sensor/Kconfig
```kconfig
#
# Sensor driver configuration
#
menuconfig INPUT_SENSOR
	bool "Sensors"
	default n
	help
	  Say Y here, and a list of supported sensorss will be displayed.
	  This option doesn't affect the kernel.

	  If unsure, say Y.

if INPUT_SENSOR

#### PRESTO ####
if MACH_MSM8X60_PRESTO
config PANTECH_PRESTO_SENSORS_APDS9190
        tristate "Avago apds9190 proximity and light sensor"
        depends on I2C
        default y
        help
          Say Y here if you have a APDS9190 sensor and want to enable
          support for the built-in sensor.

config PANTECH_PRESTO_SENSORS_YAS530
        tristate "Yamaha yas530 magnetic field sensor"
        depends on INPUT_SENSOR
        default y
        help
          Say Y here if you have a yas530 sensor and want to enable
          support for the built-in sensor.

config PANTECH_PRESTO_SENSORS_BMA250
        tristate "Bocsh bma250 accelerometer sensor"
        depends on INPUT_SENSOR
        default y
        help
          Say Y here if you have a bma250 sensor and want to enable
          support for the built-in sensor.

config PANTECH_PRESTO_SENSORS_ORIENTATION
        tristate "YAS Orientation sensor"
        depends on PANTECH_PRESTO_SENSORS_YAS530
        default y
        help
          Say Y here if you have a orientation sensor and want to enable
          support for the built-in sensor.

config SENSOR_POWER_CONTROL
	tristate "Accelermoter & Magnetic sensor power control"
	depends on INPUT_SENSOR
	default y
	help
	  Say Y here if you want to power control
endif

endif
```
